## arch/arm64/hotplug/Kconfig
```kconfig
config MAKO_HOTPLUG
 	bool "Mako Hotplug"
 	default n
 	help
 	  Mako Hotplug: A custom hotplug MOD by fransico franco
 	  
config MSM_HOTPLUG
	bool "MSM hotplug by [Fluxi]"
	depends on HOTPLUG_CPU
	default n
	help
	  The MSM hotplug driver controls on-/offlining of additional cores based on current cpu load.
	  
config ALUCARD_HOTPLUG
	bool "Enable alucard-hotplug cpu hotplug driver"
	default n
	help
	  Generic Alucard-hotplug cpu hotplug driver for ARM SOCs	  
```
